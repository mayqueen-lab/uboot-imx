## board/mayqueen/panzer/Kconfig
```kconfig
if TARGET_PANZER

config SYS_BOARD
	default "panzer"

config SYS_VENDOR
	default "mayqueen"

config SYS_CONFIG_NAME
	default "panzer"

config SYS_TEXT_BASE
	default 0x87800000
endif
```

## configs/mx6ul_panzer_defconfig
```kconfig
CONFIG_SYS_EXTRA_OPTIONS="IMX_CONFIG=board/mayqueen/panzer/imximage.cfg,MX6UL,SYS_BOOT_NAND"
CONFIG_ARM=y
CONFIG_TARGET_PANZER=y
CONFIG_DM=y
CONFIG_DM_THERMAL=y
```
